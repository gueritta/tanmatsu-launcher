## main/Kconfig
```kconfig
menu "WHY2025 board support"

    config BSP_TARGET_WHY2025
        bool "Build for WHY2025 badge"
        default n
        help
            Enable application-level support for the WHY2025 badge. This option is
            defined here in the launcher so that WHY2025-specific code paths can be
            compiled in while the badge-bsp hardware layer is selected separately via
            CONFIG_BSP_TARGET_ESP32_P4_FUNCTION_EV_BOARD.

endmenu

menu "Fast FATFS I/O"

    config FATFS_USE_FASTOPEN
        bool "Enable fast file I/O with DMA buffers"
        default n
        help
            Allocate stdio buffers in internal DMA-capable RAM for faster
            SD card and internal flash access, avoiding PSRAM cache overhead.

    config FATFS_MAX_FILES_OPEN
        int "Maximum files with fast I/O buffers"
        depends on FATFS_USE_FASTOPEN
        default 8
        range 1 32
        help
            Maximum number of concurrently open files using fast I/O buffers.

    config FATFS_STDIO_BUF_SIZE
        int "Fast I/O buffer size (bytes)"
        depends on FATFS_USE_FASTOPEN
        default 8192
        help
            Size of stdio buffer for fast file I/O. Must be power of 2.

endmenu
```
